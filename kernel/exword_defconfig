## x11/buildroot-2019-exword.defconfig
```kconfig
BR2_sh=y
BR2_sh4aeb=y
BR2_PRIMARY_SITE="https://sources.buildroot.net"
BR2_TARGET_OPTIMIZATION="-m4a-nofpu -ffunction-sections -fdata-sections -fno-unwind-tables -fno-asynchronous-unwind-tables"
BR2_TARGET_LDFLAGS="-Wl,--gc-sections"
BR2_TOOLCHAIN_BUILDROOT_MUSL=y
BR2_TOOLCHAIN_BUILDROOT_WCHAR=y
BR2_PTHREADS_NATIVE=y
BR2_OPTIMIZE_S=y
BR2_INIT_NONE=y
BR2_TARGET_GENERIC_GETTY_PORT=""
BR2_SYSTEM_BIN_SH_NONE=y
# BR2_PACKAGE_BUSYBOX is not set
# BR2_TARGET_ROOTFS_TAR is not set
BR2_PACKAGE_XORG7=y
BR2_PACKAGE_XSERVER_XORG_SERVER=y
BR2_PACKAGE_XSERVER_XORG_SERVER_V_1_20=y
BR2_PACKAGE_XSERVER_XORG_SERVER_KDRIVE=y
BR2_PACKAGE_XSERVER_XORG_SERVER_KDRIVE_EVDEV=y
BR2_PACKAGE_XAPP_XCALC=y
BR2_PACKAGE_XAPP_XEDIT=y
BR2_PACKAGE_XAPP_XMESSAGE=y
BR2_PACKAGE_XAPP_XKILL=y
BR2_PACKAGE_XTERM=y
BR2_PACKAGE_NANO=y
BR2_PACKAGE_NANO_TINY=y
BR2_PACKAGE_LESS=y
BR2_PACKAGE_BC=y
BR2_PACKAGE_FILE=y
BR2_PACKAGE_BDWGC=y
BR2_PACKAGE_LIBCONFIG=y
BR2_PACKAGE_XLIB_LIBXRANDR=y
BR2_PACKAGE_XLIB_LIBXINERAMA=y
BR2_PACKAGE_HOST_LINUX_HEADERS_CUSTOM_4_19=y
```

## x11/buildroot-overlay/package/x11r7/xlib_libXfont2/Config.in
```kconfig
config BR2_PACKAGE_XLIB_LIBXFONT2
	bool "libXfont2"
	select BR2_PACKAGE_XLIB_LIBFONTENC
	select BR2_PACKAGE_XLIB_XTRANS
	select BR2_PACKAGE_XORGPROTO
	help
	  X.Org Xfont library
```
